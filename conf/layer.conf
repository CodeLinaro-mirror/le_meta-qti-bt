## conf/layer.conf
```bitbake
BBFILES += "${LAYERDIR}/recipes/*/*.bb ${LAYERDIR}/recipes/*/*.bbappend ${LAYERDIR}/recipes-*/*/*.bb ${LAYERDIR}/recipes-products/images/*.bbappend"
BBPATH .= ":${LAYERDIR}"
BBFILE_COLLECTIONS += "qti-bt"
BBFILE_PRIORITY_qti-bt = "12"
BBFILE_PATTERN_qti-bt := "^${LAYERDIR}/"
PREFERRED_VERSION_btpower-dlkm = "1.0"
UNPACKDIR ??= "${WORKDIR}"

LAYERSERIES_COMPAT_qti-bt = "scarthgap wrynose"
```
